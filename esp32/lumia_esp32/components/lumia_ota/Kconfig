## esp32/lumia_esp32/components/lumia_ota/Kconfig
```kconfig
menu "Maurya OTA"

config LUMIA_OTA_PROTOCOL_VERSION
    int "OTA protocol version"
    default 2
    range 1 255

config LUMIA_OTA_LAYOUT_VERSION
    int "Flash layout version"
    default 2
    range 2 255

config LUMIA_OTA_ASSET_PACK_VERSION
    int "Fixed avatar asset pack version"
    default 1
    range 1 255

config LUMIA_OTA_WEB_VARIANT
    string "Web language variant"
    default "multilingual"

config LUMIA_OTA_SESSION_TIMEOUT_SECONDS
    int "OTA Wi-Fi session timeout"
    default 300
    range 60 900

config LUMIA_OTA_UPLOAD_TIMEOUT_SECONDS
    int "OTA upload inactivity timeout"
    default 20
    range 5 120

endmenu
```

## esp32/lumia_esp32/components/lumia_platform/Kconfig
```kconfig
menu "Lumia platform configuration"

    config LUMIA_BLE_DEVICE_NAME
        string "Legacy BLE name prefix fallback"
        default "Maurya"
        help
            The normal BLE name uses the Wi-Fi SoftAP prefix and MAC suffix,
            so BLE and Wi-Fi both appear as Maurya-XXXX. This value is only
            used when the Wi-Fi prefix setting is unavailable.

    config LUMIA_BLE_STATUS_LED_GPIO
        int "BLE status LED GPIO"
        range 0 21
        default 8

    config LUMIA_BLE_STATUS_LED_ACTIVE_LOW
        bool "BLE status LED active low"
        default y

    config LUMIA_MODE_BUTTON_GPIO
        int "Mode button GPIO"
        range 0 21
        default 9

    config LUMIA_MODE_BUTTON_ACTIVE_LOW
        bool "Mode button active low"
        default y

    config LUMIA_MODE_BUTTON_DEBOUNCE_MS
        int "Mode button debounce time (ms)"
        range 5 200
        default 30

    config LUMIA_MODE_BUTTON_LONG_PRESS_MS
        int "Mode button long press time (ms)"
        range 500 10000
        default 2000

    config LUMIA_SLEEP_SWITCH_GPIO
        int "Sleep control switch GPIO"
        range 0 21
        default 4

    config LUMIA_SLEEP_SWITCH_ACTIVE_LOW
        bool "Sleep control switch active low"
        default y

    config LUMIA_SLEEP_SWITCH_DEBOUNCE_MS
        int "Sleep control switch debounce time (ms)"
        range 5 200
        default 30

    config LUMIA_LED_CH1_GPIO
        int "WS2812 channel 1 GPIO"
        range 0 21
        default 0

    config LUMIA_LED_CH2_GPIO
        int "WS2812 channel 2 GPIO"
        range 0 21
        default 1

    config LUMIA_LED_CH3_GPIO
        int "WS2812 channel 3 GPIO"
        range 0 21
        default 3

    config LUMIA_LED_CH4_GPIO
        int "WS2812 channel 4 GPIO"
        range 0 21
        default 7

    config LUMIA_LED_CH5_GPIO
        int "WS2812 channel 5 GPIO"
        range 0 21
        default 10

    config LUMIA_LED_CH6_GPIO
        int "WS2812 channel 6 GPIO"
        range 0 21
        default 20

    config LUMIA_LED_CH7_GPIO
        int "WS2812 channel 7 GPIO"
        range 0 21
        default 21

    config LUMIA_LED_CH1_COUNT
        int "WS2812 channel 1 LED count"
        range 1 255
        default 6

    config LUMIA_LED_CH2_COUNT
        int "WS2812 channel 2 LED count"
        range 1 255
        default 6

    config LUMIA_LED_CH3_COUNT
        int "WS2812 channel 3 LED count"
        range 1 255
        default 6

    config LUMIA_LED_CH4_COUNT
        int "WS2812 channel 4 LED count"
        range 1 255
        default 6

    config LUMIA_LED_CH5_COUNT
        int "WS2812 channel 5 LED count"
        range 1 255
        default 6

    config LUMIA_LED_CH6_COUNT
        int "WS2812 channel 6 LED count"
        range 1 255
        default 6

    config LUMIA_LED_CH7_COUNT
        int "WS2812 channel 7 LED count"
        range 1 255
        default 6

    config LUMIA_LED_TX_PHYSICAL_MAX_COUNT
        int "WS2812 per-channel physical clear length"
        range 1 255
        default 6
        help
            Number of LEDs transmitted on each channel refresh. Values above
            the logical channel count are sent as zeros to clear the tail of a
            longer test strip. Set this to the physical strip length when using
            a long strip for bench testing; keep it at 6 for the final hardware.

    config LUMIA_LED_TX_RESET_US
        int "WS2812 inter-channel reset low time (us)"
        range 80 5000
        default 300
        help
            Extra low-level idle time inserted after each channel refresh to
            improve latch margin on long wires or long test strips.

endmenu
```

## esp32/lumia_esp32/components/lumia_web/Kconfig
```kconfig
menu "Lumia web control configuration"

    config LUMIA_WIFI_AP_SSID_PREFIX
        string "SoftAP SSID prefix"
        default "Maurya"

    config LUMIA_WIFI_AP_PASSWORD
        string "SoftAP WPA2 password"
        default "Maurya123"
        help
            Must be between 8 and 63 characters.

    config LUMIA_WIFI_AP_AUTO_CHANNEL
        bool "Select the least congested SoftAP channel at startup"
        default y
        help
            Scan once at startup and choose between non-overlapping channels
            1, 6, and 11. The configured SoftAP channel is used if scanning fails.

    config LUMIA_WIFI_AP_CHANNEL
        int "SoftAP channel (manual or automatic fallback)"
        range 1 13
        default 1

    config LUMIA_WIFI_AP_MAX_CLIENTS
        int "SoftAP maximum clients"
        range 1 4
        default 2

    config LUMIA_WIFI_CAPTIVE_DNS
        bool "Enable captive portal wildcard DNS"
        default y

endmenu
```

## esp32/lumia_esp32/sdkconfig.defaults
```kconfig
CONFIG_IDF_TARGET="esp32c3"
CONFIG_ESPTOOLPY_FLASHSIZE_4MB=y
CONFIG_PARTITION_TABLE_CUSTOM=y
CONFIG_PARTITION_TABLE_CUSTOM_FILENAME="partitions.csv"
CONFIG_BOOTLOADER_APP_ROLLBACK_ENABLE=y
CONFIG_SECURE_SIGNED_APPS_NO_SECURE_BOOT=y
CONFIG_SECURE_SIGNED_ON_UPDATE_NO_SECURE_BOOT=y
CONFIG_SECURE_BOOT_BUILD_SIGNED_BINARIES=y
CONFIG_SECURE_BOOT_SIGNING_KEY="keys/maurya-release-signing-key.pem"
CONFIG_BT_ENABLED=y
CONFIG_BT_BLUEDROID_ENABLED=n
CONFIG_BT_NIMBLE_ENABLED=y
CONFIG_COMPILER_OPTIMIZATION_SIZE=y
CONFIG_COMPILER_OPTIMIZATION_ASSERTIONS_SILENT=y
CONFIG_RMT_TX_ISR_CACHE_SAFE=y
CONFIG_RMT_ENCODER_FUNC_IN_IRAM=y
CONFIG_RMT_TX_ISR_HANDLER_IN_IRAM=y
CONFIG_LOG_DEFAULT_LEVEL_WARN=y
# Maurya only exposes an IPv4 SoftAP at 192.168.4.1. Removing the unused IPv6
# stack keeps the signed image below the 90% OTA slot release gate.
CONFIG_LWIP_IPV6=n
CONFIG_BT_NIMBLE_LOG_LEVEL_WARNING=y
CONFIG_BT_NIMBLE_PRINT_ERR_NAME=n
CONFIG_BT_NIMBLE_ROLE_CENTRAL=n
CONFIG_BT_NIMBLE_ROLE_PERIPHERAL=y
CONFIG_BT_NIMBLE_ROLE_BROADCASTER=y
CONFIG_BT_NIMBLE_ROLE_OBSERVER=n
CONFIG_BT_NIMBLE_GATT_CLIENT=n
CONFIG_BT_NIMBLE_GATT_SERVER=y
CONFIG_BT_NIMBLE_50_FEATURE_SUPPORT=n
CONFIG_BT_NIMBLE_PROX_SERVICE=n
CONFIG_BT_NIMBLE_ANS_SERVICE=n
CONFIG_BT_NIMBLE_CTS_SERVICE=n
CONFIG_BT_NIMBLE_HTP_SERVICE=n
CONFIG_BT_NIMBLE_IPSS_SERVICE=n
CONFIG_BT_NIMBLE_TPS_SERVICE=n
CONFIG_BT_NIMBLE_IAS_SERVICE=n
CONFIG_BT_NIMBLE_LLS_SERVICE=n
CONFIG_BT_NIMBLE_SPS_SERVICE=n
CONFIG_BT_NIMBLE_HR_SERVICE=n
CONFIG_BT_NIMBLE_BAS_SERVICE=n
CONFIG_BT_NIMBLE_DIS_SERVICE=n
CONFIG_BT_NIMBLE_DTM_MODE_TEST=n
CONFIG_BT_NIMBLE_EXTRA_ADV_FIELDS=n
CONFIG_ESP_WIFI_ENABLE_WPA3_SAE=n
CONFIG_ESP_WIFI_ENABLE_WPA3_OWE_STA=n
CONFIG_ESP_WIFI_GMAC_SUPPORT=n
CONFIG_ESP_WIFI_ENTERPRISE_SUPPORT=n
CONFIG_VFS_SUPPORT_DIR=n
CONFIG_LUMIA_BLE_DEVICE_NAME="Maurya"
CONFIG_LUMIA_MODE_BUTTON_GPIO=9
CONFIG_LUMIA_MODE_BUTTON_ACTIVE_LOW=y
CONFIG_LUMIA_MODE_BUTTON_DEBOUNCE_MS=30
CONFIG_LUMIA_MODE_BUTTON_LONG_PRESS_MS=2000
CONFIG_LUMIA_SLEEP_SWITCH_GPIO=4
CONFIG_LUMIA_SLEEP_SWITCH_ACTIVE_LOW=y
CONFIG_LUMIA_SLEEP_SWITCH_DEBOUNCE_MS=30
CONFIG_LUMIA_BLE_STATUS_LED_GPIO=8
CONFIG_LUMIA_BLE_STATUS_LED_ACTIVE_LOW=y
CONFIG_LUMIA_WIFI_AP_SSID_PREFIX="Maurya"
CONFIG_LUMIA_WIFI_AP_PASSWORD="CHANGE_ME_BEFORE_RELEASE"
CONFIG_LUMIA_WIFI_AP_AUTO_CHANNEL=y
CONFIG_LUMIA_WIFI_AP_CHANNEL=1
CONFIG_LUMIA_WIFI_AP_MAX_CLIENTS=2
CONFIG_LUMIA_WIFI_CAPTIVE_DNS=y
CONFIG_LUMIA_OTA_PROTOCOL_VERSION=2
CONFIG_LUMIA_OTA_LAYOUT_VERSION=2
CONFIG_LUMIA_OTA_ASSET_PACK_VERSION=1
CONFIG_LUMIA_OTA_WEB_VARIANT="multilingual"
CONFIG_LUMIA_OTA_SESSION_TIMEOUT_SECONDS=300
CONFIG_LUMIA_OTA_UPLOAD_TIMEOUT_SECONDS=20
CONFIG_LUMIA_LED_CH1_GPIO=0
CONFIG_LUMIA_LED_CH2_GPIO=1
CONFIG_LUMIA_LED_CH3_GPIO=3
CONFIG_LUMIA_LED_CH4_GPIO=7
CONFIG_LUMIA_LED_CH5_GPIO=10
CONFIG_LUMIA_LED_CH6_GPIO=20
CONFIG_LUMIA_LED_CH7_GPIO=21
CONFIG_LUMIA_LED_CH1_COUNT=6
CONFIG_LUMIA_LED_CH2_COUNT=6
CONFIG_LUMIA_LED_CH3_COUNT=6
CONFIG_LUMIA_LED_CH4_COUNT=6
CONFIG_LUMIA_LED_CH5_COUNT=6
CONFIG_LUMIA_LED_CH6_COUNT=6
CONFIG_LUMIA_LED_CH7_COUNT=6
CONFIG_LUMIA_LED_TX_PHYSICAL_MAX_COUNT=6
CONFIG_LUMIA_LED_TX_RESET_US=300
```
